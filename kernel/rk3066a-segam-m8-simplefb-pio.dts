// SPDX-License-Identifier: (GPL-2.0+ OR MIT)
/* Bring-up variant: SD without DMA */
#include "rk3066a-segam-m8-simplefb.dts"

/ {
	model = "SEGAM M8 V5.0 (simplefb, SD without DMA)";
};

&mmc0 {
	/delete-property/ dmas;
	/delete-property/ dma-names;
};
