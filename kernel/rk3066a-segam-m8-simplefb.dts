// SPDX-License-Identifier: (GPL-2.0+ OR MIT)
/* First bring-up: the picture set up by the stock kernel is kept (1280x720 RGB565) and
 * used as console. No display driver, no HDMI audio. */
/dts-v1/;
#include "rk3066a-segam-m8.dtsi"

/ {
	model = "SEGAM M8 V5.0 (simplefb)";

	chosen {
		bootargs = "console=tty0 loglevel=4 clk_ignore_unused pd_ignore_unused regulator_ignore_unused maxcpus=1 oops=panic panic=120 rdinit=/init";
	};
};

/* the stock LCDC keeps scanning the framebuffer */
&vop0 {
	status = "disabled";
};
